## boards/shields/super_ergo_test/Kconfig.shield
```kconfig
config SHIELD_SUPER_ERGO_TEST
    def_bool $(shields_list_contains,super_ergo_test)
```

## config/boards/shields/super_ergo_test/Kconfig.defconfig
```kconfig
if SHIELD_SUPER_ERGO_TEST_LEFT || SHIELD_SUPER_ERGO_TEST_RIGHT

config ZMK_KEYBOARD_NAME
    default "Super Ergo"

config ZMK_SPLIT
    default y

endif # SHIELD_SUPER_ERGO_TEST_LEFT || SHIELD_SUPER_ERGO_TEST_RIGHT

if SHIELD_SUPER_ERGO_TEST_LEFT

config ZMK_SPLIT_ROLE_CENTRAL
    default y

endif # SHIELD_SUPER_ERGO_TEST_LEFT
```

## config/boards/shields/super_ergo_test/Kconfig.shield
```kconfig
config SHIELD_SUPER_ERGO_TEST_LEFT
    def_bool $(shields_list_contains,super_ergo_test_left)

config SHIELD_SUPER_ERGO_TEST_RIGHT
    def_bool $(shields_list_contains,super_ergo_test_right)

config SHIELD_SUPER_ERGO_RIGHT_DEBUG
    def_bool $(shields_list_contains,super_ergo_right_debug)
```

## config/boards/super_ergo_test/Kconfig.defconfig
```kconfig
if SHIELD_SUPER_ERGO_TEST

config ZMK_KEYBOARD_NAME
    default "super_ergo_test"

endif # SHIELD_SUPER_ERGO_TEST
```
