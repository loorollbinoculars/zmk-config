// See https://zmk.dev/docs/development/hardware-integration/physical-layouts
// for how to configure this.

#include <physical_layouts.dtsi>

/ {
    default_layout: default_layout {
        compatible = "zmk,physical-layout";
        display-name = "Default Layout";
        transform = <&default_transform>;
        kscan = <&kscan>;

        // keys property removed - add it back when defining physical layout for ZMK Studio
        // https://zmk.dev/docs/development/hardware-integration/physical-layouts#optional-keys-property
    };
};
